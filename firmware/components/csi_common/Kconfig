## firmware/components/csi_common/Kconfig
```kconfig
menu "CSI Motion Sensor (common)"

    config CSI_CHANNEL
        int "Wi-Fi channel used by both sender and receiver (2.4 GHz)"
        range 1 13
        default 11
        help
            Sender and receiver MUST use the same channel. Pick the least
            congested channel in your room (check with a phone Wi-Fi analyzer).

    config CSI_TX_POWER_QDBM
        int "Sender TX power in 0.25 dBm units (8..84)"
        range 8 84
        default 40
        help
            40 = 10 dBm. Lower power shrinks the sensing area and reduces
            interference from far away. 84 = 21 dBm (maximum).
            Used by the sender only.

endmenu
```

## firmware/csi_recv/main/Kconfig.projbuild
```kconfig
menu "CSI Receiver"

    config CSI_USE_HTLTF
        bool "Also capture HT-LTF (doubles the data per packet)"
        default n
        help
            Off: only the legacy LTF (64 subcarriers, 128 values per packet) is
            captured. That is enough for motion detection. A line is roughly
            440 bytes, about 44 KB/s at 100 packets/s (921600 baud carries ~92 KB/s).
            On: HT-LTF is appended (256 values per packet, ~76 KB/s at 100
            packets/s). That leaves little margin, so use <= 50 packets/s and
            watch the "dropped" counter reported by `csi-motion check`.

    config CSI_QUEUE_LEN
        int "Packets buffered between the Wi-Fi task and the serial writer"
        range 4 256
        default 32

endmenu
```

## firmware/csi_send/main/Kconfig.projbuild
```kconfig
menu "CSI Sender"

    config CSI_SEND_PERIOD_MS
        int "Interval between ESP-NOW packets (ms)"
        range 2 1000
        default 10
        help
            10 ms = 100 packets/s. The receiver gets one CSI sample per packet,
            so this is the CSI sampling rate. specs/phase1.md requires at least 50 Hz (default 100).

endmenu
```
